#include "oled.h"
#include <cstring>

SSD1306::SSD1306(const struct device *i2c, uint8_t addr)
                                :  i2c_(i2c), addr_(addr) 
{
    memset(buffer_, 0, sizeof(buffer_));
}

int SSD1306::writeCmd(uint8_t cmd)
{
    uint8_t buf[2] = {0x00, cmd};  // 0x00 – управляющий байт: команда
    return i2c_write(i2c_, buf, sizeof(buf), addr_);
}

int SSD1306::writeData(const uint8_t *data, size_t len) 
{
    uint8_t buf[33];
    buf[0] = 0x40;  // Control byte: данные

    while (len > 0) {
        const size_t chunk_ = (len > 32) ? 32 : len;
        memcpy(&buf[1], data, chunk_);
        const int ret = i2c_write(i2c_, buf, chunk_ + 1, addr_);
        if (ret < 0)
            return ret;

        data += chunk_;
        len -= chunk_;
    }

    return 0;
}

bool SSD1306::init()
{
    if (i2c_ == nullptr || !device_is_ready(i2c_)) 
    {
        return false;
    }
    k_msleep(100);

    auto cmd = [this](uint8_t value) /* Что это? */
    {
        return writeCmd(value) == 0;
    };

    if (!cmd(SSD1306_SET_DISP_OFF))           return false;

    if (!cmd(SSD1306_SET_DISP_CLK_DIV))       return false;
    if (!cmd(0x80))                           return false;

    if (!cmd(SSD1306_SET_MUX_RATIO))          return false;
    if (!cmd(OLED_HEIGHT - 1))                return false;

    if (!cmd(SSD1306_SET_DISP_OFFSET))        return false;
    if (!cmd(0x00))                           return false;

    if (!cmd(SSD1306_SET_DISP_START_LINE))    return false;

    if (!cmd(SSD1306_SET_CHARGE_PUMP))        return false;
    if (!cmd(0x14))                           return false;

    if (!cmd(SSD1306_SET_MEM_MODE))           return false;
    if (!cmd(0x00))                           return false;

    if (!cmd(SSD1306_SET_SEG_REMAP | 0x01))   return false;
    if (!cmd(SSD1306_SET_COM_OUT_DIR | 0x08)) return false;

    if (!cmd(SSD1306_SET_COM_PIN_CFG))        return false;
    if (!cmd(0x02))                           return false;

    if (!cmd(SSD1306_SET_CONTRAST))           return false;
    if (!cmd(0x7F))                           return false;

    if (!cmd(SSD1306_SET_ENTIRE_ON))          return false;
    if (!cmd(SSD1306_SET_NORM_DISP))          return false;

    clear();

    if (!update()) 
    {
        return false;
    }

    if (!cmd(SSD1306_SET_DISP_ON)) 
    {
        return false;
    }

    return true;
}

void SSD1306::clear()
{
    memset(buffer_, 0, sizeof(buffer_));
}

bool SSD1306::update()
{
    if (writeCmd(SSD1306_SET_COL_ADDR) < 0) 
    {
        return false;
    }

    if (writeCmd(0) < 0) 
    {
        return false;
    }

    if (writeCmd(OLED_WIDTH - 1) < 0) 
    {
        return false;
    }

    if (writeCmd(SSD1306_SET_PAGE_ADDR) < 0) 
    {
        return false;
    }

    if (writeCmd(0) < 0) 
    {
        return false;
    }

    if (writeCmd((OLED_HEIGHT / 8) - 1) < 0) 
    {
        return false;
    }

    return writeData(buffer_, sizeof(buffer_)) == 0;
}

// ----- Draw pixel -----
void SSD1306::drawPixel(int16_t x, int16_t y, bool color)
{
    if (x < 0 || x >= OLED_WIDTH || y < 0 || y >= OLED_HEIGHT) return;
    uint16_t idx = x + (y / 8) * OLED_WIDTH;
    uint8_t bit = 1 << (y % 8);
    if (color) buffer_[idx] |= bit;
    else       buffer_[idx] &= ~bit;
}

// ----- Шрифт 5x7 (символы ASCII 32..127) -----
// Каждый символ – 5 байт (по 5 столбцов), биты строки 0..6 (7 строк)
static const uint8_t font5x7[][5] = 
{
    {0x00, 0x00, 0x00, 0x00, 0x00}, // 32 space
    {0x00, 0x00, 0x5F, 0x00, 0x00}, // 33 !
    {0x00, 0x07, 0x00, 0x07, 0x00}, // 34 "
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    {0x00, 0x00, 0x00, 0x00, 0x00}  // 127 DEL (пусто)
};

void SSD1306::drawChar(int16_t x, int16_t y, char c, bool color) 
{
    if (c < 32 || c > 127) c = 32;
    uint8_t idx = c - 32;
    for (int col = 0; col < 5; col++) 
    {
        uint8_t line = font5x7[idx][col];
        for (int row = 0; row < 7; row++) 
        {
            if (line & (1 << row)) 
            {
                drawPixel(x + col, y + row, color);
            }
        }
    }
}

void SSD1306::drawString(int16_t x, int16_t y, const char *str, bool color) 
{
    while (*str) 
    {
        drawChar(x, y, *str++, color);
        x += 6; // 5 пикселей ширина + 1 пробел
        if (x + 5 >= OLED_WIDTH) // перенос строки
        { 
            x = 0;
            y += 8;
        }
    }
}
